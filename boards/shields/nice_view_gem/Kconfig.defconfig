## boards/shields/nice_view_gem/Kconfig.defconfig
```kconfig
if SHIELD_NICE_VIEW_GEM

config LV_Z_VDB_SIZE
    default 100

config LV_DPI_DEF
    default 161

config LV_Z_BITS_PER_PIXEL
    default 1

choice LV_COLOR_DEPTH
    default LV_COLOR_DEPTH_1
endchoice

choice ZMK_DISPLAY_WORK_QUEUE
    default ZMK_DISPLAY_WORK_QUEUE_DEDICATED
endchoice

choice ZMK_DISPLAY_STATUS_SCREEN
    default ZMK_DISPLAY_STATUS_SCREEN_CUSTOM
endchoice

config LV_Z_MEM_POOL_SIZE
    default 4096 if ZMK_DISPLAY_STATUS_SCREEN_CUSTOM

config ZMK_DISPLAY_STATUS_SCREEN_CUSTOM
    imply NICE_VIEW_WIDGET_STATUS

config NICE_VIEW_GEM_WPM_FIXED_RANGE
    bool "Enable fixed range for WPM gauge/chart"
    default y

config NICE_VIEW_GEM_WPM_FIXED_RANGE_MAX
    int "Fixed range maximum for WPM gauge/chart"
    default 100

config NICE_VIEW_GEM_ANIMATION
    bool "Animate the art (n = show a still frame of a random slide)"
    default y

config NICE_VIEW_GEM_SLIDESHOW_INTERVAL_S
    int "Seconds each slideshow animation plays before switching (at the end of its loop)"
    default 300

config NICE_VIEW_GEM_ANIMATION_SPEED_PCT
    int "Frame time in percent of each animation's own pacing (200 = half speed, less battery)"
    range 25 1000
    default 100

config NICE_VIEW_GEM_LAYER_ANIMATION_NAME
    string "Layer name (display-name) that shows the arcade animation on the left half"
    default "Tibia"

config NICE_VIEW_GEM_ANIMATION_PAUSE_ON_IDLE
    bool "Freeze the animation while the keyboard half is idle"
    default y
    depends on NICE_VIEW_GEM_ANIMATION

config NICE_VIEW_WIDGET_STATUS
    select LV_USE_LABEL
    select LV_USE_IMG
    select LV_USE_CANVAS
    select LV_USE_ANIMATION

config NICE_VIEW_WIDGET_INVERTED
    bool "Invert display colors"

if !ZMK_SPLIT || ZMK_SPLIT_ROLE_CENTRAL

config NICE_VIEW_WIDGET_STATUS
    select ZMK_WPM

endif # !ZMK_SPLIT || ZMK_SPLIT_ROLE_CENTRAL

endif # SHIELD_NICE_VIEW_GEM
```
